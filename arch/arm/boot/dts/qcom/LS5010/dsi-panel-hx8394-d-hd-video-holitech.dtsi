/* Copyright (c) 2020, The Linux Foundation. All rights reserved.
*  Copyright (c) 2020, the_shahnawaz_sheikh (sheikhshahnawaz41299).
*
* This program is free software; you can redistribute it and/or modify
* it under the terms of the GNU General Public License version 2 and
* only version 2 as published by the Free Software Foundation.
*
* This program is distributed in the hope that it will be useful,
* but WITHOUT ANY WARRANTY; without even the implied warranty of
* MERCHANTABILITY or FITNESS FOR A PARTICULAR PURPOSE.  See the
* GNU General Public License for more details.
*/

&mdss_mdp {
	dsi_hx8394_d_hd_video_holitech: qcom,mdss_dsi_hx8394_d_hd_video_holitech {
				qcom,mdss-dsi-panel-name = "hx8394_d hd video holitech mode dsi panel";
				qcom,mdss-dsi-panel-controller = <&mdss_dsi0>;
				qcom,mdss-dsi-panel-type = "dsi_video_mode";
				qcom,mdss-dsi-panel-destination = "display_1";
				qcom,mdss-dsi-panel-framerate = <60>;
				qcom,mdss-dsi-virtual-channel-id = <0>;
				qcom,mdss-dsi-stream = <0>;
				qcom,mdss-dsi-panel-width = <720>;
				qcom,mdss-dsi-panel-height = <1280>;
				qcom,mdss-dsi-h-front-porch = <150>;
				qcom,mdss-dsi-h-back-porch = <150>;
				qcom,mdss-dsi-h-pulse-width = <17>;
				qcom,mdss-dsi-h-sync-skew = <0>;
				qcom,mdss-dsi-v-back-porch = <12>;
				qcom,mdss-dsi-v-front-porch = <16>;
				qcom,mdss-dsi-v-pulse-width = <4>;
				qcom,mdss-dsi-h-left-border = <0>;
				qcom,mdss-dsi-h-right-border = <0>;
				qcom,mdss-dsi-v-top-border = <0>;
				qcom,mdss-dsi-v-bottom-border = <0>;
				qcom,mdss-dsi-bpp = <24>;
				qcom,mdss-dsi-color-order = <0>;
				qcom,mdss-dsi-underflow-color = <0xff>;
				qcom,mdss-dsi-border-color = <0>;
				qcom,mdss-dsi-on-command-holitech-a-si = [39 01 00 00 00 00 04 b9 ff 83 94 39 01 00 00 00 00 03 ba 33 83 39 01 00 00 00 00 10 b1 6c 10 0d 01 04 11 f1 80 d4 db 23 80 c0 d2 58 39 01 00 00 00 00 0c b2 00 64 0e 0d 32 23 08 08 1c 4d 00 39 01 00 00 00 00 0d b4 00 ff 03 5a 03 6a 03 6a 01 70 01 70 39 01 00 00 00 00 04 bf 41 0e 01 39 01 00 00 00 00 26 d3 00 07 00 00 00 10 08 32 10 00 00 00 32 13 c0 00 00 32 10 08 00 00 33 00 04 04 37 04 00 27 00 00 00 00 0a 00 01 39 01 00 00 00 00 2d d5 00 01 02 03 04 05 06 07 20 21 22 23 18 18 18 18 24 25 18 18 26 27 18 18 18 18 18 18 18 18 18 18 18 18 18 18 18 18 24 25 19 19 18 18 39 01 00 00 00 00 2d d6 07 06 05 04 03 02 01 00 23 22 21 20 18 18 18 18 18 18 58 58 18 18 18 18 18 18 18 18 18 18 18 18 18 18 18 18 18 18 25 24 18 18 19 19 39 01 00 00 00 00 2b e0 00 00 00 20 39 3f 06 2d 04 07 0a 16 0d 10 13 10 12 06 0d 0f 12 00 00 00 20 39 3f 06 2d 04 07 0a 16 0d 10 13 10 12 06 0d 0f 12 39 01 00 00 00 00 02 cc 09 39 01 00 00 00 00 05 c7 00 c0 00 c0 39 01 00 00 00 00 03 b6 2d 2d 05 01 00 00 78 00 02 11 00 05 01 00 00 10 00 02 29 00];
				qcom,mdss-dsi-off-command = [05 01 00 00 32 00 02 28 00 05 01 00 00 78 00 02 10 00];
				qcom,mdss-dsi-on-command-state = "dsi_lp_mode";
				qcom,mdss-dsi-off-command-state = "dsi_hs_mode";
				qcom,mdss-dsi-h-sync-pulse = <0>;
				qcom,mdss-dsi-traffic-mode = "burst_mode";
				qcom,mdss-dsi-lane-map = "lane_map_0123";
				qcom,mdss-dsi-bllp-eof-power-mode;
				qcom,mdss-dsi-bllp-power-mode;
				qcom,mdss-dsi-lane-0-state;
				qcom,mdss-dsi-lane-1-state;
				qcom,mdss-dsi-lane-2-state;
				qcom,mdss-dsi-lane-3-state;
				qcom,mdss-dsi-panel-timings = <0x531e1400 0x44481822 0x19030400>;
				qcom,mdss-dsi-t-clk-post = <0x1f>;
				qcom,mdss-dsi-t-clk-pre = <0x2d>;
				qcom,mdss-dsi-bl-min-level = <20>;
				qcom,mdss-dsi-bl-max-level = <255>;
				qcom,mdss-dsi-dma-trigger = "trigger_sw";
				qcom,mdss-dsi-mdp-trigger = "none";
				qcom,mdss-dsi-bl-pmic-control-type = "bl_ctrl_pwm";
				qcom,mdss-dsi-bl-pmic-pwm-frequency = <20>;
				qcom,mdss-dsi-bl-pmic-bank-select = <0>;
				qcom,mdss-dsi-pwm-gpio = <&pm8916_mpps 4 0>;
				qcom,mdss-dsi-reset-sequence = <1 20 0 2 1 20>;
				qcom,mdss-pan-physical-width-dimension = <63>;
				qcom,mdss-pan-physical-height-dimension = <111>;
				qcom,cont-splash-enabled;
				qcom,esd-check-enabled;
				qcom,mdss-dsi-panel-status-check-mode = "bta_check";
			};
};
