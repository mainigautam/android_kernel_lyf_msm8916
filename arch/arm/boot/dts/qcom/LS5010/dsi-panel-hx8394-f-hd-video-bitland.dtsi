/* Copyright (c) 2020, The Linux Foundation. All rights reserved.
*  Copyright (c) 2020, the_shahnawaz_sheikh (sheikhshahnawaz41299).
*
* This program is free software; you can redistribute it and/or modify
* it under the terms of the GNU General Public License version 2 and
* only version 2 as published by the Free Software Foundation.
*
* This program is distributed in the hope that it will be useful,
* but WITHOUT ANY WARRANTY; without even the implied warranty of
* MERCHANTABILITY or FITNESS FOR A PARTICULAR PURPOSE.  See the
* GNU General Public License for more details.
*/

&mdss_mdp {
	dsi_hx8394_f_hd_video_bitland: qcom,mdss_dsi_hx8394_f_hd_video_bitland {
				qcom,mdss-dsi-panel-name = "hx8394_f hd video bitland mode dsi panel";
				qcom,mdss-dsi-panel-controller = <&mdss_dsi0>;
				qcom,mdss-dsi-panel-type = "dsi_video_mode";
				qcom,mdss-dsi-panel-destination = "display_1";
				qcom,mdss-dsi-panel-framerate = <60>;
				qcom,mdss-dsi-virtual-channel-id = <0>;
				qcom,mdss-dsi-stream = <0x0>;
				qcom,mdss-dsi-panel-width = <720>;
				qcom,mdss-dsi-panel-height = <1280>;
				qcom,mdss-dsi-h-front-porch = <150>;
				qcom,mdss-dsi-h-back-porch = <150>;
				qcom,mdss-dsi-h-pulse-width = <17>;
				qcom,mdss-dsi-h-sync-skew = <0>;
				qcom,mdss-dsi-v-back-porch = <12>;
				qcom,mdss-dsi-v-front-porch = <16>;
				qcom,mdss-dsi-v-pulse-width = <4>;
				qcom,mdss-dsi-h-left-border = <0>;
				qcom,mdss-dsi-h-right-border = <0>;
				qcom,mdss-dsi-v-top-border = <0>;
				qcom,mdss-dsi-v-bottom-border = <0>;
				qcom,mdss-dsi-bpp = <24>;
				qcom,mdss-dsi-color-order = <0>;
				qcom,mdss-dsi-underflow-color = <0xff>;
				qcom,mdss-dsi-border-color = <0>;
				qcom,mdss-dsi-on-command-bitland-ds = [39 01 00 00 00 00 04 b9 ff 83 94 39 01 00 00 00 00 07 ba 63 03 68 6b b2 c0 39 01 00 00 00 00 0b b1 50 12 72 09 32 54 71 51 30 43 39 01 00 00 00 00 07 b2 00 80 64 0b 06 2f 39 01 00 00 00 00 16 b4 1c 78 1c 78 1c 78 01 05 ff 75 00 3f 1c 78 1c 78 1c 78 01 05 ff 39 01 00 00 00 00 22 d3 00 00 00 00 00 00 10 10 32 10 03 00 03 32 13 c0 00 00 32 10 08 00 00 37 04 05 05 37 05 05 47 0e 40 39 01 00 00 00 00 2d d5 18 18 18 18 00 01 02 03 04 05 06 07 18 18 18 18 18 18 18 18 18 18 18 18 18 18 18 18 18 18 18 18 18 18 18 18 19 19 19 19 20 21 22 23 39 01 00 00 00 00 2d d6 18 18 19 19 07 06 05 04 03 02 01 00 18 18 18 18 18 18 18 18 27 26 18 18 18 18 18 18 18 18 18 18 18 18 18 18 19 19 18 18 23 22 21 20 39 01 00 00 00 00 02 cc 0b 39 01 00 00 00 00 03 c0 1f 73 39 01 00 00 00 00 05 c7 00 c0 40 c0 39 01 00 00 00 00 03 b6 3c 3c 39 01 00 00 00 00 3b e0 00 05 0b 11 12 16 19 17 30 40 50 4f 58 69 6f 71 7f 82 7e 8d 9e 4f 4f 53 58 5d 67 74 7f 00 05 0b 11 12 16 19 17 30 40 50 4f 58 69 6f 71 7f 82 7e 8d 9e 4f 4f 53 58 5d 67 74 7f 39 01 00 00 00 00 02 d4 02 05 01 00 00 78 00 02 11 00 05 01 00 00 14 00 02 29 00];
				qcom,mdss-dsi-off-command = [05 01 00 00 32 00 02 28 00 05 01 00 00 78 00 02 10 00];
				qcom,mdss-dsi-on-command-state = "dsi_lp_mode";
				qcom,mdss-dsi-off-command-state = "dsi_hs_mode";
				qcom,mdss-dsi-h-sync-pulse = <0x0>;
				qcom,mdss-dsi-traffic-mode = "burst_mode";
				qcom,mdss-dsi-lane-map = "lane_map_0123";
				qcom,mdss-dsi-bllp-eof-power-mode;
				qcom,mdss-dsi-bllp-power-mode;
				qcom,mdss-dsi-lane-0-state;
				qcom,mdss-dsi-lane-1-state;
				qcom,mdss-dsi-lane-2-state;
				qcom,mdss-dsi-lane-3-state;
				qcom,mdss-dsi-panel-timings = <0x531e1400 0x44481822 0x19030400>;
				qcom,mdss-dsi-t-clk-post = <0x1f>;
				qcom,mdss-dsi-t-clk-pre = <0x2d>;
				qcom,mdss-dsi-bl-min-level = <20>;
				qcom,mdss-dsi-bl-max-level = <255>;
				qcom,mdss-dsi-dma-trigger = "trigger_sw";
				qcom,mdss-dsi-mdp-trigger = "none";
				qcom,mdss-dsi-bl-pmic-control-type = "bl_ctrl_pwm";
				qcom,mdss-dsi-bl-pmic-pwm-frequency = <20>;
				qcom,mdss-dsi-bl-pmic-bank-select = <0>;
				qcom,mdss-dsi-pwm-gpio = <&pm8916_mpps 4 0>;
				qcom,mdss-dsi-reset-sequence = <1 20 0 2 1 20>;
				qcom,mdss-pan-physical-width-dimension = <63>;
				qcom,mdss-pan-physical-height-dimension = <111>;
				qcom,cont-splash-enabled;
				qcom,esd-check-enabled;
				qcom,mdss-dsi-panel-status-check-mode = "bta_check";
			};
};
